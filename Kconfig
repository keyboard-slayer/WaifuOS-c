## Kconfig
```kconfig
# Copyright (C) 2022 Keyboard Slayer
#
# This file is part of WaifuOS.
#
# WaifuOS is free software: you can redistribute it and/or modify
# it under the terms of the GNU General Public License as published by
# the Free Software Foundation, either version 3 of the License, or
# (at your option) any later version.
#
# WaifuOS is distributed in the hope that it will be useful,
# but WITHOUT ANY WARRANTY; without even the implied warranty of
# MERCHANTABILITY or FITNESS FOR A PARTICULAR PURPOSE.  See the
# GNU General Public License for more details.
#
# You should have received a copy of the GNU General Public License
# along with WaifuOS.  If not, see <http://www.gnu.org/licenses/>.




mainmenu "Kernel Configuration"

source "src/arch/Kconfig"
source "src/loader/Kconfig"
source "src/kernel/Kconfig"

menu "Emulation options"
    config ENBABLE_KVM
        bool "Enable KVM"
        depends on !DUMP_INTERRUPT
        default y
        help
            Enable KVM support.

    config DUMP_INTERRUPT
        bool "Dump interrupt state"
        default n
        help 
            Dump interrupt state on each interrupt.
    

    config NO_POWEROFF
        bool "No poweroff"
        default n
        help
            Do not power off the machine when the kernel exits.
    
    config MEMORY
        int "Memory size (MB)"
        default 256
        help
            Memory size in MB.
    
    config CPU_CORE
        int "Cpu Core"
        default 4
        help
            Cpu Core.

    config EFI_BIOS_PATH
        string "EFI bios path"
        default "/usr/share/ovmf/x64/OVMF_CODE.fd"
        depends on LOADER_EFI
        help
            EFI bios path.
endmenu
```

## src/libs/abstract/Kconfig
```kconfig
# Copyright (C) 2022 Keyboard Slayer
#
# This file is part of WaifuOS.
#
# WaifuOS is free software: you can redistribute it and/or modify
# it under the terms of the GNU General Public License as published by
# the Free Software Foundation, either version 3 of the License, or
# (at your option) any later version.
#
# WaifuOS is distributed in the hope that it will be useful,
# but WITHOUT ANY WARRANTY; without even the implied warranty of
# MERCHANTABILITY or FITNESS FOR A PARTICULAR PURPOSE.  See the
# GNU General Public License for more details.
#
# You should have received a copy of the GNU General Public License
# along with WaifuOS.  If not, see <http://www.gnu.org/licenses/>.

menu "Bootloader"
    choice
        prompt "Bootloader to use"
        default LOADER_LIMINE
        help 
            Select the bootloader to use.
            The default is limine.

        config LOADER_LIMINE
            bool "Limine"
            depends on ARCH_X86-64
            help
                Use limine as bootloader.
    endchoice

    config LOADER_EFI
        bool "EFI"
        depends on LOADER_LIMINE
        default y
endmenu

choice
    prompt "Architecture"
    default ARCH_X86-64

config ARCH_X86-64
    bool "x86 (64-bit) architecture"

endchoice

source "src/arch/x86_64/Kconfig"
```
